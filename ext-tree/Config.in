## ext-tree/Config.in
```kconfig
menu "Santa Clone"
    source "$BR2_EXTERNAL_SANTA_CLONE_PATH/package/santa_kmod/Config.in"
    source "$BR2_EXTERNAL_SANTA_CLONE_PATH/package/rust_santa_daemon/Config.in"
endmenu
```

## ext-tree/configs/santa-clone-qemu_x86_64_defconfig
```kconfig
BR2_x86_64=y
BR2_CCACHE=y
# BR2_STRIP_strip is not set
BR2_OPTIMIZE_1=y
BR2_PIC_PIE=y
BR2_SSP_REGULAR=y
BR2_RELRO_PARTIAL=y
BR2_TOOLCHAIN_BUILDROOT_GLIBC=y
BR2_PACKAGE_HOST_LINUX_HEADERS_CUSTOM_5_4=y
BR2_PACKAGE_GLIBC_UTILS=y
BR2_TOOLCHAIN_BUILDROOT_CXX=y
BR2_SYSTEM_BIN_SH_BASH=y
BR2_SYSTEM_DHCP="eth0"
BR2_ROOTFS_OVERLAY="../ext-tree/overlay"
BR2_ROOTFS_POST_BUILD_SCRIPT="board/qemu/x86_64/post-build.sh"
BR2_ROOTFS_POST_IMAGE_SCRIPT="board/qemu/post-image.sh"
BR2_ROOTFS_POST_SCRIPT_ARGS="$(BR2_DEFCONFIG)"
BR2_LINUX_KERNEL=y
BR2_LINUX_KERNEL_CUSTOM_VERSION=y
BR2_LINUX_KERNEL_CUSTOM_VERSION_VALUE="5.4.58"
BR2_LINUX_KERNEL_USE_CUSTOM_CONFIG=y
BR2_LINUX_KERNEL_CUSTOM_CONFIG_FILE="../ext-tree/configs/linux.config"
BR2_LINUX_KERNEL_NEEDS_HOST_OPENSSL=y
BR2_LINUX_KERNEL_NEEDS_HOST_LIBELF=y
BR2_PACKAGE_BUSYBOX_SHOW_OTHERS=y
BR2_PACKAGE_LTRACE=y
BR2_PACKAGE_STRACE=y
BR2_PACKAGE_BINUTILS=y
BR2_PACKAGE_BINUTILS_TARGET=y
BR2_PACKAGE_MAKE=y
BR2_PACKAGE_SED=y
BR2_PACKAGE_GNUTLS=y
BR2_PACKAGE_GNUTLS_OPENSSL=y
BR2_PACKAGE_GNUTLS_TOOLS=y
BR2_PACKAGE_LIBNFNETLINK=y
BR2_PACKAGE_BASH_COMPLETION=y
BR2_PACKAGE_FILE=y
BR2_PACKAGE_TMUX=y
BR2_PACKAGE_COREUTILS=y
BR2_PACKAGE_UTIL_LINUX=y
BR2_PACKAGE_VIM=y
BR2_TARGET_ROOTFS_EXT2=y
BR2_TARGET_ROOTFS_EXT2_SIZE="1200M"
# BR2_TARGET_ROOTFS_TAR is not set
BR2_PACKAGE_HOST_QEMU=y
BR2_PACKAGE_HOST_QEMU_SYSTEM_MODE=y
BR2_PACKAGE_SANTA_DAEMON=y
BR2_PACKAGE_SANTA_KMOD=y
```

## ext-tree/package/rust_santa_daemon/Config.in
```kconfig
config BR2_PACKAGE_RUST_SANTA_DAEMON
    bool "rust_santa_daemon"
    depends on BR2_PACKAGE_HOST_RUSTC_ARCH_SUPPORTS
    select BR2_PACKAGE_HOST_RUSTC
    select BR2_PACKAGE_HOST_CARGO
    help
        rust version of the Santa daemon package.
```

## ext-tree/package/santa_kmod/Config.in
```kconfig
config BR2_PACKAGE_SANTA_KMOD
        bool "santa_kmod"
        depends on BR2_LINUX_KERNEL
        help
                Santa clone kernel module component.
```
